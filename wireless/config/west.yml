## wireless/config/west.yml
```yaml
manifest:
  remotes:
    - name: splitkb
      url-base: https://github.com/splitkb
  projects:
    - name: zmk
      remote: splitkb
      revision: f0821fb5e7f1577bcfce36fb4ce899cfb395f00a
      import: app/west.yml
    - name: zmk-halcyon-module
      remote: splitkb
      revision: a83eaa492a678ed12fb5feabc62426dc1ed3a3cb
  self:
    path: config
```

## wireless/firmware/diagnostic-right-2026-10-13/west.yml
```yaml
manifest:
  remotes:
    - name: splitkb
      url-base: https://github.com/splitkb
  projects:
    - name: zmk
      remote: splitkb
      revision: efbf0195bb2fac61c47896e3b7d5d3165679bc33
      import: app/west.yml
    - name: zmk-halcyon-module
      remote: splitkb
      revision: a5adc646208d733856042eacb371e1556fe0e044
  self:
    path: config
```
